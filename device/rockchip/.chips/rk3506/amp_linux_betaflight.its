## device/rockchip/.chips/rk3506/amp_linux_betaflight.its
```
/* SPDX-License-Identifier: BSD-3-Clause */

/dts-v1/;
/ {
	description = "PowerFin Betaflight bare-metal boot";
	#address-cells = <1>;

	images {
		amp2 {
			description = "betaflight-core2";
			data = /incbin/("betaflight2.bin");
			type = "firmware";
			compression = "none";
			arch = "arm";
			cpu = <0xf02>;
			thumb = <0>;
			hyp = <0>;
			load = <0x02e00000>;
			compile {
				size = <0x00100000>;
				sys = "betaflight";
				core = "ap";
			};
			udelay = <10000>;
			hash {
				algo = "sha256";
			};
		};
	};

	configurations {
		default = "conf";
		conf {
			description = "PowerFin AMP images";
			rollback-index = <0x0>;
			loadables = "amp2";

			signature {
				algo = "sha256,rsa2048";
				padding = "pss";
				key-name-hint = "dev";
				sign-images = "loadables";
			};

			linux {
				description = "linux-os";
				arch = "arm";
				cpu = <0xf00>;
				thumb = <0>;
				hyp = <0>;
				load = <0x00900000>;
				boot-on = <0>;
				udelay = <0>;
			};
		};
	};
};
```

## device/rockchip/.chips/rk3506/powerfin-boot.its
```
/*
 * SPDX-License-Identifier: GPL-2.0
 */

/dts-v1/;
/ {
	description = "PowerFin normal and recovery boot image";

	images {
		fdt-normal {
			data = /incbin/("@KERNEL_DTB@");
			type = "flat_dt";
			arch = "arm";
			compression = "none";
			load = <0xffffff00>;

			hash {
				algo = "sha256";
			};
		};

		fdt-recovery {
			data = /incbin/("@RECOVERY_KERNEL_DTB@");
			type = "flat_dt";
			arch = "arm";
			compression = "none";
			load = <0xffffff00>;

			hash {
				algo = "sha256";
			};
		};

		fdt-motor-pwm {
			data = /incbin/("@MOTOR_PWM_DTBO@");
			type = "flat_dt";
			arch = "arm";
			compression = "none";
			load = <0x000f0000>;

			hash {
				algo = "sha256";
			};
		};

		fdt-spi1-pwm {
			data = /incbin/("@SPI1_PWM_DTBO@");
			type = "flat_dt";
			arch = "arm";
			compression = "none";
			load = <0x000f8000>;

			hash {
				algo = "sha256";
			};
		};

		kernel {
			data = /incbin/("@KERNEL_IMG@");
			type = "kernel";
			arch = "arm";
			os = "linux";
			compression = "none";
			entry = <0xffffff01>;
			load = <0xffffff01>;

			hash {
				algo = "sha256";
			};
		};

		ramdisk-recovery {
			data = /incbin/("@RAMDISK_IMG@");
			type = "ramdisk";
			arch = "arm";
			os = "linux";
			compression = "none";
			load = <0xffffff02>;

			hash {
				algo = "sha256";
			};
		};
	};

	configurations {
		default = "conf-normal";

		conf-normal {
			fdt = "fdt-normal";
			kernel = "kernel";
		};

		motor-pwm {
			fdt = "fdt-motor-pwm";
		};

		spi1-pwm {
			fdt = "fdt-spi1-pwm";
		};

		conf-recovery {
			fdt = "fdt-recovery";
			kernel = "kernel";
			ramdisk = "ramdisk-recovery";
		};
	};
};
```

## device/rockchip/.chips/rk3506/powerfin-ramboot.its
```
/*
 * SPDX-License-Identifier: GPL-2.0
 */

/dts-v1/;
/ {
	description = "PowerFin kernel fast-boot debug image";

	images {
		fdt {
			data = /incbin/("@KERNEL_DTB@");
			type = "flat_dt";
			arch = "arm";
			compression = "none";
			load = <0xffffff00>;

			hash {
				algo = "sha256";
			};
		};

		kernel {
			data = /incbin/("@KERNEL_IMG@");
			type = "kernel";
			arch = "arm";
			os = "linux";
			compression = "none";
			entry = <0xffffff01>;
			load = <0xffffff01>;

			hash {
				algo = "sha256";
			};
		};

		ramdisk {
			data = /incbin/("@RAMDISK_IMG@");
			type = "ramdisk";
			arch = "arm";
			os = "linux";
			compression = "none";
			load = <0xffffff02>;

			hash {
				algo = "sha256";
			};
		};

	};

	configurations {
		default = "conf";

		conf {
			fdt = "fdt";
			kernel = "kernel";
			ramdisk = "ramdisk";
		};
	};
};
```

## device/rockchip/.chips/rk3506/powerfin-sdroot.its
```
/*
 * SPDX-License-Identifier: GPL-2.0
 */

/dts-v1/;
/ {
	description = "PowerFin SD rootfs boot image";

	images {
		fdt {
			data = /incbin/("@KERNEL_DTB@");
			type = "flat_dt";
			arch = "arm";
			compression = "none";
			load = <0xffffff00>;

			hash {
				algo = "sha256";
			};
		};

		kernel {
			data = /incbin/("@KERNEL_IMG@");
			type = "kernel";
			arch = "arm";
			os = "linux";
			compression = "none";
			entry = <0xffffff01>;
			load = <0xffffff01>;

			hash {
				algo = "sha256";
			};
		};
	};

	configurations {
		default = "conf";

		conf {
			fdt = "fdt";
			kernel = "kernel";
		};
	};
};
```
